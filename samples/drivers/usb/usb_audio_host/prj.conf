## CMakeLists.txt
```
# Copyright (c) 2025 Alif Semiconductor
# SPDX-License-Identifier: Apache-2.0

cmake_minimum_required(VERSION 3.20.0)
find_package(Zephyr REQUIRED HINTS $ENV{ZEPHYR_BASE})
project(usb_audio_host)

target_sources(app PRIVATE src/main.c src/audio_gen.c)

# Place USB host DMA buffers in SRAM0
zephyr_linker_sources(DATA_SECTIONS ${CMAKE_CURRENT_SOURCE_DIR}/uhc_dma.ld)
```

## prj.conf
```kconfig
# Copyright (c) 2025 Alif Semiconductor
# SPDX-License-Identifier: Apache-2.0

CONFIG_LOG=y
CONFIG_LOG_DEFAULT_LEVEL=3
CONFIG_LOG_BUFFER_SIZE=16384

CONFIG_USB_HOST_STACK=y
CONFIG_UHC_DWC3=y

CONFIG_MAIN_STACK_SIZE=4096
CONFIG_SYSTEM_WORKQUEUE_STACK_SIZE=2048
```

## src/main.c
```c
/*
 * Copyright (c) 2025 Alif Semiconductor
 * SPDX-License-Identifier: Apache-2.0
 *
 * USB Audio Host Sample
 *
 * Enumerates a USB audio headset (headphone + mic), configures its
 * isochronous endpoints, and streams audio.
 *
 * The playback source is selectable via TEST_MODE in audio_gen.h (embedded
 * clip, silence, 440 Hz tone, or the default live mic->speaker loopback).
 * The clip/silence/tone frame generators live in audio_gen.c.
 *
 * To replace the test clip with your own WAV file:
 *   cd alif/samples/drivers/usb/usb_audio_host
 *   python3 scripts/wav_to_header.py your_file.wav src/audio_clip.h
 *
 * Tested with generic USB headsets (VID=0x3654 PID=0x4155, FS, UAC 1.0)
 *
 * Build:
 *   west build -b alif_e8_dk/ae822fa0e5597xx0/rtss_hp \
 *     alif/samples/drivers/usb/usb_audio_host \
 *     -- -DDTC_OVERLAY_FILE=boards/alif_usb_host.overlay
 */

#include <zephyr/kernel.h>
#include <zephyr/device.h>
#include <zephyr/usb/usbh.h>
#include <zephyr/drivers/usb/uhc.h>
#include <zephyr/drivers/usb/uhc_dwc3.h>
#include <zephyr/sys/byteorder.h>

#include "audio_gen.h"

#include <zephyr/logging/log.h>
LOG_MODULE_REGISTER(usb_audio_host, LOG_LEVEL_INF);

/* Get the UHC device from devicetree */
#define UHC_NODE DT_NODELABEL(zephyr_uhc0)

#if !DT_NODE_EXISTS(UHC_NODE)
#error "zephyr_uhc0 node not found. Check overlay."
#endif

static const struct device *uhc_dev = DEVICE_DT_GET(UHC_NODE);

USBH_CONTROLLER_DEFINE(sample_uhs_ctx, DEVICE_DT_GET(UHC_NODE));

/* Audio parameters discovered from config descriptor */
struct audio_config {
	uint8_t spk_iface;	/* Speaker streaming interface number */
	uint8_t spk_alt;	/* Speaker alt setting (with endpoint) */
	uint8_t spk_ep;		/* Speaker isoch OUT endpoint address */
	uint16_t spk_mps;	/* Speaker max packet size */
	uint8_t mic_iface;	/* Mic streaming interface number */
	uint8_t mic_alt;	/* Mic alt setting (with endpoint) */
	uint8_t mic_ep;		/* Mic isoch IN endpoint address */
	uint16_t mic_mps;	/* Mic max packet size */
	uint8_t cfg_val;	/* bConfigurationValue */
};

/* Event callback */
static int usb_host_event_cb(const struct device *dev,
			     const struct uhc_event *const event)
{
	switch (event->type) {
	case UHC_EVT_DEV_CONNECTED_FS:
		LOG_INF(">>> USB device connected (Full Speed)");
		break;
	case UHC_EVT_DEV_CONNECTED_HS:
		LOG_INF(">>> USB device connected (High Speed)");
		break;
	case UHC_EVT_DEV_REMOVED:
		LOG_INF(">>> USB device disconnected");
		break;
	default:
		break;
	}

	return 0;
}

/*
 * Parse the configuration descriptor to find USB Audio Class
 * streaming interfaces and their isochronous endpoints.
 */
static int parse_audio_config(const uint8_t *desc, int len,
			      struct audio_config *acfg)
{
	int offset = 0;
	uint8_t cur_iface = 0;
	uint8_t cur_alt = 0;
	uint8_t cur_class = 0;
	uint8_t cur_subclass = 0;

	memset(acfg, 0, sizeof(*acfg));

	while (offset < len) {
		uint8_t dlen = desc[offset];
		uint8_t dtype = desc[offset + 1];

		if (dlen == 0) {
			break;
		}

		if (dtype == 0x02 && (offset + 6) <= len) {
			/* Configuration descriptor */
			acfg->cfg_val = desc[offset + 5];
			LOG_INF("[%3d] CONFIG: bConfigVal=%u bNumIfaces=%u",
				offset, acfg->cfg_val, desc[offset + 4]);
		}

		if (dtype == 0x04 && (offset + 9) <= len) {
			/* Interface descriptor */
			cur_iface = desc[offset + 2];
			cur_alt = desc[offset + 3];
			cur_class = desc[offset + 5];
			cur_subclass = desc[offset + 6];

			LOG_INF("[%3d] IFACE %u alt=%u eps=%u class=0x%02x sub=0x%02x",
				offset, cur_iface, cur_alt,
				desc[offset + 4], cur_class, cur_subclass);
		}

		if (dtype == 0x05 && (offset + 7) <= len) {
			/* Endpoint descriptor */
			uint8_t ep_addr = desc[offset + 2];
			uint8_t ep_attr = desc[offset + 3];
			uint16_t ep_mps = desc[offset + 4] |
					  (desc[offset + 5] << 8);

			LOG_INF("[%3d] EP 0x%02x attr=0x%02x mps=%u interval=%u",
				offset, ep_addr, ep_attr, ep_mps,
				desc[offset + 6]);

			/* Audio Streaming isoch endpoint? */
			if (cur_class == 0x01 && cur_subclass == 0x02 &&
			    (ep_attr & 0x03) == 0x01) {
				if (!(ep_addr & 0x80)) {
					/* Isoch OUT = speaker */
					acfg->spk_iface = cur_iface;
					acfg->spk_alt = cur_alt;
					acfg->spk_ep = ep_addr;
					acfg->spk_mps = ep_mps;
					LOG_INF("  -> Speaker EP 0x%02x mps=%u (iface %u alt %u)",
						ep_addr, ep_mps,
						cur_iface, cur_alt);
				} else {
					/* Isoch IN = microphone */
					acfg->mic_iface = cur_iface;
					acfg->mic_alt = cur_alt;
					acfg->mic_ep = ep_addr;
					acfg->mic_mps = ep_mps;
					LOG_INF("  -> Mic EP 0x%02x mps=%u (iface %u alt %u)",
						ep_addr, ep_mps,
						cur_iface, cur_alt);
				}
			}
		}

		if (dtype == 0x24 && (offset + 3) <= len) {
			/* Class-specific interface descriptor */
			LOG_INF("[%3d] CS_INTERFACE subtype=%u len=%u",
				offset, desc[offset + 2], dlen);
		}

		offset += dlen;
	}

	return 0;
}

int main(void)
{
	int err;

	LOG_INF("USB Audio Host Sample");
	LOG_INF("=====================");

	if (!device_is_ready(uhc_dev)) {
		LOG_ERR("USB host controller device not ready");
		return -ENODEV;
	}

	err = uhc_init(uhc_dev, usb_host_event_cb, &sample_uhs_ctx);
	if (err) {
		LOG_ERR("Failed to initialize UHC: %d", err);
		return err;
	}

	err = uhc_enable(uhc_dev);
	if (err) {
		LOG_ERR("Failed to enable UHC: %d", err);
		return err;
	}

	LOG_INF("Waiting for USB audio device...");

	bool streaming = false;

	while (true) {
		if (streaming) {
			/* Stream for a fixed window, then stop so the deferred
			 * log thread can drain the buffered diagnostics. The
			 * pump busy-waits and never yields during streaming, so
			 * logs only flush once we stop and sleep below.
			 */
			static uint32_t stream_start_ms;

			if (stream_start_ms == 0) {
				stream_start_ms = k_uptime_get_32();
			}
			if ((k_uptime_get_32() - stream_start_ms) >= 10000) {
				LOG_INF("Stream window elapsed — stopping to "
					"flush logs");
				streaming = false;
				stream_start_ms = 0;
				k_sleep(K_MSEC(500)); /* let log thread drain */
				continue;
			}

			/* Playback source is selected by TEST_MODE in
			 * audio_gen.h. Loopback (the default) is pumped by the
			 * driver; the clip/silence/tone modes generate frames
			 * via audio_gen_next().
			 */
#if TEST_MODE == AUDIO_MODE_LOOPBACK
			/* Live loopback: the driver pumps mic IN -> speaker OUT
			 * each frame, dispatching both endpoints' completions
			 * off the shared event ring. The mic's async sample
			 * count drives the speaker rate, so no shedding is needed.
			 */
			int lb_ret = uhc_dwc3_isoch_loopback(uhc_dev);

			if (lb_ret < 0) {
				LOG_ERR("Loopback failed: %d", lb_ret);
				streaming = false;
				continue;
			}

			static int lb_frame_count;
			static uint32_t lb_last_log_time;

			lb_frame_count++;
			if ((lb_frame_count % 1000) == 0) {
				uint32_t now = k_uptime_get_32();
				uint32_t elapsed = now - lb_last_log_time;

				LOG_INF("Loopback: 1000 frames in %u ms",
					elapsed);
				lb_last_log_time = now;
			}

			continue;
#else
			/* Generate one playback frame (clip / silence / tone)
			 * with rate shedding applied - see audio_gen.c.
			 */
			size_t frame_bytes;
			const uint8_t *frame_ptr = audio_gen_next(&frame_bytes);

			int ret = uhc_dwc3_isoch_out(uhc_dev, frame_ptr,
						     frame_bytes);
			if (ret < 0) {
				LOG_ERR("Isoch OUT failed: %d", ret);
				streaming = false;
				continue;
			}

			/* Log timing every 1000 frames */
			static int frame_count;
			static uint32_t last_log_time;

			frame_count++;
			if ((frame_count % 1000) == 0) {
				uint32_t now = k_uptime_get_32();
				uint32_t elapsed = now - last_log_time;

				LOG_INF("Playback: 1000 frames in %u ms "
					"(%u us/frame avg)",
					elapsed, elapsed * 1000 / 1000);
				last_log_time = now;
			}

			continue;
#endif
		}

		k_sleep(K_SECONDS(2));

		volatile uint32_t *portsc =
			(volatile uint32_t *)(DT_REG_ADDR(UHC_NODE) + 0x420);
		uint32_t ps = *portsc;

		if (!(ps & BIT(0))) {
			LOG_INF("No device connected, PORTSC=0x%08x", ps);
			continue;
		}

		LOG_INF("Device detected, enumerating...");
		k_sleep(K_MSEC(1000));

		/* Re-check after settle */
		ps = *portsc;
		if (!(ps & BIT(0))) {
			LOG_WRN("Device gone during settle");
			continue;
		}

		/* Step 1: Enumerate */
		struct usb_device_descriptor desc;

		err = uhc_dwc3_enumerate_device(uhc_dev, &desc);
		if (err) {
			LOG_ERR("Enumeration failed: %d", err);
			k_sleep(K_SECONDS(5));
			continue;
		}

		LOG_INF("Device: VID=0x%04x PID=0x%04x Class=%u",
			sys_le16_to_cpu(desc.idVendor),
			sys_le16_to_cpu(desc.idProduct),
			desc.bDeviceClass);

		/* Step 2: Read full config descriptor */
		uint8_t cfg_hdr[9];

		err = uhc_dwc3_control_transfer(uhc_dev, 0x80, 0x06,
						0x0200, 0, 9, cfg_hdr);
		if (err < 0) {
			LOG_ERR("Get config header failed: %d", err);
			continue;
		}

		uint16_t total_len = cfg_hdr[2] | (cfg_hdr[3] << 8);

		LOG_INF("Config descriptor: total_len=%u", total_len);

		if (total_len > 512) {
			total_len = 512;
		}

		uint8_t full_cfg[512];

		err = uhc_dwc3_control_transfer(uhc_dev, 0x80, 0x06,
						0x0200, 0, total_len,
						full_cfg);
		if (err < 0) {
			LOG_ERR("Get full config failed: %d", err);
			continue;
		}

		/* Step 3: Parse audio descriptors */
		struct audio_config acfg;

		parse_audio_config(full_cfg, err, &acfg);

		if (acfg.spk_ep == 0 && acfg.mic_ep == 0) {
			LOG_ERR("No audio streaming endpoints found");
			k_sleep(K_SECONDS(10));
			continue;
		}

		LOG_INF("Audio config:");
		LOG_INF("  Speaker: EP 0x%02x mps=%u (iface %u alt %u)",
			acfg.spk_ep, acfg.spk_mps,
			acfg.spk_iface, acfg.spk_alt);
		LOG_INF("  Mic:     EP 0x%02x mps=%u (iface %u alt %u)",
			acfg.mic_ep, acfg.mic_mps,
			acfg.mic_iface, acfg.mic_alt);

		/* Step 4: Set Configuration */
		LOG_INF("=== Set Configuration %u ===", acfg.cfg_val);
		err = uhc_dwc3_control_transfer(uhc_dev, 0x00, 0x09,
						acfg.cfg_val, 0, 0, NULL);
		if (err < 0) {
			LOG_ERR("Set Configuration failed: %d", err);
			continue;
		}

		/* Step 5: Set Interface alt setting to activate audio EPs.
		 * Audio streaming interfaces start with alt=0 (zero-bandwidth)
		 * and must be switched to alt=1 to activate the isoch endpoint.
		 */
		if (acfg.spk_ep) {
			LOG_INF("=== SET_INTERFACE iface=%u alt=%u (speaker) ===",
				acfg.spk_iface, acfg.spk_alt);
			err = uhc_dwc3_control_transfer(
				uhc_dev, 0x01, 0x0B,
				acfg.spk_alt, acfg.spk_iface, 0, NULL);
			if (err < 0) {
				LOG_ERR("SET_INTERFACE speaker failed: %d",
					err);
				continue;
			}
		}

		if (acfg.mic_ep) {
			LOG_INF("=== SET_INTERFACE iface=%u alt=%u (mic) ===",
				acfg.mic_iface, acfg.mic_alt);
			err = uhc_dwc3_control_transfer(
				uhc_dev, 0x01, 0x0B,
				acfg.mic_alt, acfg.mic_iface, 0, NULL);
			if (err < 0) {
				LOG_ERR("SET_INTERFACE mic failed: %d", err);
				continue;
			}
		}

		/* Step 6: Configure isochronous endpoints in xHCI */
		LOG_INF("=== Configure Isoch Endpoints ===");
		err = uhc_dwc3_configure_isoch(uhc_dev,
					       acfg.spk_ep, acfg.mic_ep,
					       acfg.spk_mps, acfg.mic_mps);
		if (err) {
			LOG_ERR("Configure isoch EP failed: %d", err);
			continue;
		}

		LOG_INF("Audio streaming ready!");

		/* Prime the isoch rings with silence frames */
		err = uhc_dwc3_isoch_start(uhc_dev, acfg.spk_mps,
					   acfg.mic_mps);
		if (err) {
			LOG_ERR("Isoch start failed: %d", err);
			continue;
		}

		streaming = true;
	}

	return 0;
}
```

## src/audio_gen.c
```c
/*
 * Copyright (c) 2025 Alif Semiconductor
 * SPDX-License-Identifier: Apache-2.0
 *
 * Audio frame generation helpers for the USB audio host sample.
 */

#include <string.h>
#include <stdint.h>

#include "audio_gen.h"

/* Stereo, 16-bit PCM at 48 kHz: one 1 ms USB frame carries up to 48 samples. */
#define AUDIO_CHANNELS		2
#define BYTES_PER_SAMPLE	2
#define MAX_SAMPLES_PER_FRAME	48
#define FRAME_BUF_BYTES	\
	(MAX_SAMPLES_PER_FRAME * BYTES_PER_SAMPLE * AUDIO_CHANNELS)

#if TEST_MODE == AUDIO_MODE_CLIP
#include "audio_clip.h"

/* Copy nsamp stereo frames from the embedded clip, wrapping at the end. */
static void fill_clip(int16_t *dst, int nsamp)
{
	static int clip_offset;
	int total = AUDIO_CLIP_NUM_FRAMES * AUDIO_CLIP_CHANNELS;

	for (int i = 0; i < nsamp * AUDIO_CHANNELS; i++) {
		dst[i] = audio_clip_data[clip_offset++];
		if (clip_offset >= total) {
			clip_offset = 0;
		}
	}
}
#elif TEST_MODE == AUDIO_MODE_TONE
/*
 * One approximate cycle of 440 Hz at 48 kHz. The true period is 109.09
 * samples, so the 48-entry table is indexed through a 109-sample phase.
 */
static const int16_t sine_table[48] = {
	0,     2139,  4240,  6270,  8192,  9974, 11585, 12998,
	14189, 15137, 15826, 16244, 16384, 16244, 15826, 15137,
	14189, 12998, 11585, 9974,  8192,  6270,  4240,  2139,
	0,    -2139, -4240, -6270, -8192, -9974,-11585,-12998,
	-14189,-15137,-15826,-16244,-16384,-16244,-15826,-15137,
	-14189,-12998,-11585, -9974, -8192, -6270, -4240, -2139,
};
#define SINE_PERIOD		109  /* samples per 440 Hz period at 48 kHz */
#define SINE_TABLE_LEN		48

/* Generate nsamp stereo frames of a continuous-phase 440 Hz tone. */
static void fill_tone(int16_t *dst, int nsamp)
{
	static int phase;

	for (int i = 0; i < nsamp; i++) {
		int idx = (phase * SINE_TABLE_LEN) / SINE_PERIOD;
		int16_t v = sine_table[idx];

		dst[i * 2] = v;
		dst[i * 2 + 1] = v;
		phase++;
		if (phase >= SINE_PERIOD) {
			phase = 0;
		}
	}
}
#endif

const uint8_t *audio_gen_next(size_t *bytes)
{
	static uint8_t frame_buf[FRAME_BUF_BYTES];
	int nsamp = MAX_SAMPLES_PER_FRAME;

#if SHED_MILLISAMPLES > 0
	/*
	 * Fractional sample shedding: keep a running remainder and drop one
	 * sample whenever it exceeds a whole sample, yielding a long-run
	 * average of (48 - SHED_MILLISAMPLES/1000) samples per frame.
	 */
	static int shed_acc;

	shed_acc += SHED_MILLISAMPLES;
	if (shed_acc >= 1000) {
		shed_acc -= 1000;
		nsamp--;
	}
#endif

	*bytes = (size_t)nsamp * BYTES_PER_SAMPLE * AUDIO_CHANNELS;

#if TEST_MODE == AUDIO_MODE_CLIP
	fill_clip((int16_t *)frame_buf, nsamp);
#elif TEST_MODE == AUDIO_MODE_TONE
	fill_tone((int16_t *)frame_buf, nsamp);
#else /* AUDIO_MODE_SILENCE (loopback does not call this) */
	memset(frame_buf, 0, *bytes);
#endif

	return frame_buf;
}
```

## src/audio_gen.h
```c
/*
 * Copyright (c) 2025 Alif Semiconductor
 * SPDX-License-Identifier: Apache-2.0
 *
 * Audio frame generation helpers for the USB audio host sample.
 *
 * These generate one USB frame of stereo 16-bit PCM at 48 kHz for the
 * playback test modes. The live loopback mode does not use them - the driver
 * pumps mic IN straight to speaker OUT.
 */

#ifndef USB_AUDIO_HOST_AUDIO_GEN_H_
#define USB_AUDIO_HOST_AUDIO_GEN_H_

#include <stddef.h>
#include <stdint.h>

/*
 * Playback source selection. This isolates the source of audio artifacts by
 * swapping the frame generator while keeping the USB path identical.
 */
#define AUDIO_MODE_CLIP		0	/* embedded arpeggio clip (audio_clip.h) */
#define AUDIO_MODE_SILENCE	1	/* all-zero frames */
#define AUDIO_MODE_TONE		2	/* steady 440 Hz tone */
#define AUDIO_MODE_LOOPBACK	3	/* live mic -> speaker (driver pumps) */

/* Active playback mode. */
#define TEST_MODE		AUDIO_MODE_LOOPBACK

/*
 * Rate adaptation for the generated playback modes (clip/silence/tone).
 * The host emits ~1008.6 USB frames/s but the DAC consumes a true 48000
 * samples/s, so a flat 48 samples/frame overflows the device FIFO (a click
 * roughly every 0.4 s). Shed a fractional sample per frame: add this value to
 * an accumulator each frame and drop one sample when it passes 1000.
 *   0   = no shed (48.000 samples/frame)
 *   410 = 47.590 samples/frame (confirmed click-free)
 * The live loopback mode needs no shedding.
 */
#define SHED_MILLISAMPLES	410

/**
 * @brief Produce the next generated playback frame
 *
 * Fills an internal buffer with one USB frame of stereo 16-bit PCM according
 * to @c TEST_MODE (clip, silence or tone), applying the rate-shedding
 * accumulator. Not used in loopback mode.
 *
 * @param bytes Set to the number of valid bytes in the returned buffer
 * @return pointer to the internal frame buffer
 */
const uint8_t *audio_gen_next(size_t *bytes);

#endif /* USB_AUDIO_HOST_AUDIO_GEN_H_ */
```
