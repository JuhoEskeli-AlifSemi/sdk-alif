## samples/modules/tflite-micro/alif_object_detection/Kconfig
```kconfig
config ACTIVATION_BUF_SECTION
	string "Linker section where activation buffer (tensor arena) is placed"
	default "SRAM1.activation_buf"

config ACTIVATION_BUF_SZ
	hex "Tensor arena size"
	default 0x200000

config MODEL_SECTION
	string "Linker section where ML model is placed"
	default ".rodata.tflm_model"

# LVGL UI options only apply when the display stack is enabled.
if LVGL

config OD_LIVE_PREVIEW
	bool "Show every camera frame, independently of inference"
	default y if DT_HAS_ALIF_UVC_HOST_ENABLED
	help
	  A separate thread shows each camera frame as it arrives and offers
	  it to inference, which takes the newest one whenever it is free.
	  The image then moves at the camera frame rate and the detection
	  boxes follow at the inference rate. Without it the image is updated
	  once per inference.

config LV_FONT_MONTSERRAT_16
	default y

config LV_FONT_MONTSERRAT_24
	default y

config LV_FONT_MONTSERRAT_28
	default y

config LV_FONT_MONTSERRAT_32
	default y

config LV_THEME_DEFAULT_DARK
	default y

config LV_Z_MEM_POOL_SIZE
	default 49152

endif # LVGL

source "Kconfig.zephyr"
	
```

## samples/modules/tflite-micro/alif_object_detection/boards/alif_e7_dk_rtss_hp.conf
```kconfig
# old
#CONFIG_ETHOS_U_AXI0_ONLY=y
#CONFIG_MIPI_DSI=y

#from video sample
CONFIG_VIDEO=y
CONFIG_LOG=y
CONFIG_PRINTK=y
CONFIG_STDOUT_CONSOLE=y
CONFIG_I2C_TARGET=y
CONFIG_I2C=y
CONFIG_I2C_DW_CLOCK_SPEED=100
CONFIG_SYS_HEAP_AUTO=y
```
