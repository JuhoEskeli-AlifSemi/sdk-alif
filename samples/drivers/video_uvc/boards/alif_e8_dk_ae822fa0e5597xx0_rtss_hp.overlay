/* Copyright (C) 2026 Alif Semiconductor - All Rights Reserved.
 * Use, distribution and modification of this code are permitted under the
 * terms stated in the Alif Semiconductor Software License Agreement.
 *
 * You should have received a copy of the Alif Semiconductor Software
 * License Agreement with this file. If not, please write to:
 * contact@alifsemi.com, or visit: https://alifsemi.com/license
 *
 * E8 DK (RTSS-HP) UVC pipeline - common board plumbing shared by all sensors.
 *
 * This overlay is applied automatically for every E8 DK build (by board name).
 * The E8 pipeline itself (USB, NON_SECURE0, AIPM, ISP/CPI graph, CSI receiver,
 * JPEG, UVC) is shared with the E8 AppKit in e8_isp_jpeg_uvc.dtsi; this file
 * adds the DK-only part, the i2c-mux that carries the camera I2C.
 *
 * It deliberately wires NO sensor: the E8 DK has no default camera. Pick one by
 * adding its sensor overlay with EXTRA_DTC_OVERLAY_FILE (arx3a0 / mt9m114 /
 * ov5675 - see the README). That sensor overlay drops the sensor node into the
 * i2c-mux channel (&cam_i2c_channel) and supplies the CSI input endpoint
 * (&csi port@0) with the sensor's lane count, which is the only part of the CSI
 * receiver that differs between the three sensors.
 */

#include <dt-bindings/gpio/gpio.h>

#include "e8_isp_jpeg_uvc.dtsi"

&gpio14 {
	status = "okay";
};

/*
 * GPIO-controlled I2C mux that fronts the camera bus. The sensor node is added
 * to the mux channel (&cam_i2c_channel) by the sensor overlay; the mux and
 * channel scaffolding are identical for every sensor.
 */
/ {
	i2c_mux: i2c-mux {
		compatible = "gpio-i2c-mux";
		status = "okay";
		#address-cells = <1>;
		#size-cells = <0>;

		i2c-inst = <&i2c1>;

		ctrl-gpios = <&gpio14 3 GPIO_ACTIVE_HIGH>;

		cam_i2c_channel: mux_i2c@0 {
			compatible = "gpio-i2c-mux-channel";
			reg = <0>;

			#address-cells = <1>;
			#size-cells = <0>;

			/* Sensor node is added here by the sensor overlay. */
		};
	};
};
